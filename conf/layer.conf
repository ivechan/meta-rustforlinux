## conf/layer.conf
```bitbake
# We have a conf and classes directory, add to BBPATH
BBPATH .= ":${LAYERDIR}"

# We have recipes-* directories, add to BBFILES
BBFILES += "${LAYERDIR}/recipes-*/*/*.bb \
            ${LAYERDIR}/recipes-*/*/*.bbappend"

BBFILE_COLLECTIONS += "rustforlinux"
BBFILE_PATTERN_rustforlinux = "^${LAYERDIR}/"
BBFILE_PRIORITY_rustforlinux = "5"

LAYERDEPENDS_rustforlinux = "core"
LAYERSERIES_COMPAT_rustforlinux = "kirkstone"
```
